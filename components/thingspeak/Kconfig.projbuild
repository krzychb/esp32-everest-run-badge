## components/thingspeak/Kconfig.projbuild
```kconfig
menu "Posting data to ThinngSpeak"

config THINGSPEAK_WRITE_API_KEY
    string "ThindSpeak write API key"
	default "1234567890123456"
	help
		API key obtained from 'https://thingspeak.com/' site.
		
		You need to set up a free account on this site first.

endmenu
```

## components/weather/Kconfig.projbuild
```kconfig
menu "Wather data retreival from OpenWeatherMap"

config OPENWEATHERMAP_API_KEY
    string "OpenWeatherMap API key"
	default "12345678901234567890123456789012"
	help
		API key obtained from 'https://home.openweathermap.org/' site.
		
		You need to set up a free account on this site first.

endmenu
```

## main/Kconfig.projbuild
```kconfig
menu "Blink setttings"

config RED_BLINK_GPIO
    int "Red blink GPIO number"
	range 0 34
	default 18
	help
		GPIO number (IOxx) to blink red.

		Some GPIOs are used for other purposes (flash connections, etc.) and cannot be used to blink.

		GPIOs 35-39 are input-only so cannot be used as outputs.

config GREEN_BLINK_GPIO
    int "Green blink GPIO number"
	range 0 34
	default 17
	help
		GPIO number (IOxx) to blink green.

		Some GPIOs are used for other purposes (flash connections, etc.) and cannot be used to blink.

		GPIOs 35-39 are input-only so cannot be used as outputs.

config BLUE_BLINK_GPIO
    int "Blue blink GPIO number"
	range 0 34
	default 16
	help
		GPIO number (IOxx) to blink blue.

		Some GPIOs are used for other purposes (flash connections, etc.) and cannot be used to blink.

		GPIOs 35-39 are input-only so cannot be used as outputs.

endmenu
```
